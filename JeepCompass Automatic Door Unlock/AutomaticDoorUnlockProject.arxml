AUTOSAR XML (schema 00050)
standard types defined: Boolean
package /ARRoot
  trigger-interface:
    trigger AutomaticDoorUnlockLeftTrigger
    trigger AutomaticDoorUnlockRightTrigger
  application sw component type AutomaticDoorUnlockControllerType
    require port AutomaticDoorUnlockLeft
    require port AutomaticdoorUnlockRight
    behavior AutomaticDoorUnlockIB
      runnable AutomaticDoorUnlockLeftRunnable: synchronous-server-call-point=AutomaticDoorUnlockLeft.
      runnable AutomaticDoorUnlockRightRunnable: synchronous-server-call-point=AutomaticdoorUnlockRight.
  swc implementation AutomaticDoorUnlockImpFile: programming-language=C, behavior=AutomaticDoorUnlockControllerType/AutomaticDoorUnlockIB
  swc implementation AutomaticDoorUnlockLeft: programming-language=C
  client server interface AutomaticDoorUnlockLeftCSIF: client-server-operation
  client server interface AutomaticDoorUnlockRightCSIF: client-server-operation
  sensor actuator sw component type AutomaticDoorUnlockSwType
    provide port AutomaticDoorUnlockLeft
    provide port AutomaticDoorUnlockRight
    behavior AutomaticDoorUnlockIB
      runnable AutomaticDoorUnlockLeftOp: external-triggering-point=AutomaticDoorUnlockLeft.AutomaticDoorUnlockLeftTrigger
      runnable AutomaticDoorUnlockRightOp: external-triggering-point=AutomaticDoorUnlockRight.AutomaticDoorUnlockRightTrigger
