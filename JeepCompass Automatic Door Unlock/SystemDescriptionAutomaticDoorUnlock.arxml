AUTOSAR XML (schema 00050)
package /ARRoot
  can cluster AutomaticDoorUnlockCanLeftCluster
    can physical channel AutomaticDoorUnlockLeftCanPhysicalChannel: comm-connectors=AutomaticDoorUnlockLeftCanCommunicationConnector
  can cluster AutomaticDoorUnlockCanRightCluster
    can physical channel AutomaticDoorUnlockRightCanPhysicalChannel: comm-connectors=AutomaticDoorUnlockLeftCanCommunicationConnector
  ecu instance AutomaticDoorUnlockLeftECUInstance
    can communication controller AutomaticDoorUnlockLeftCanCommunicationController
    can communication connector AutomaticDoorUnlockLeftCanCommunicationConnector: comm-controller=AutomaticDoorUnlockLeftCanCommunicationController
  flat map AutomaticDoorUnlockLeftFlatMap: instances=flat-instance-descriptor=AutomaticdoorUnlockLeftSystem.AutomaticDoorUnlockLeftRootSoftwareComposition.AutomaticDoorUnlockLeft
  ecu instance AutomaticDoorUnlockRightECUInstance
    can communication controller AutomaticDoorUnlockRightCanCommunicationController
    can communication connector AutomaticDoorUnlockRightCanCommunicationConnector: comm-controller=AutomaticDoorUnlockRightCanCommunicationController
  flat map AutomaticDoorUnlockRightFlatMap: instances=flat-instance-descriptor=AutomaticdoorUnlockRightSystem.AutomaticDoorUnlockRightOp.AutomaticdoorUnlockRight
  composition sw component type AutomaticDoorUnlockTopLevelComposition
    component AutomaticDoorUnlockLeftSwComponentProto: type=AutomaticDoorUnlockControllerType
    component AutomaticDoorUnlockRightSwComponentProto: type=AutomaticDoorUnlockControllerType
    delegation sw connector AutomaticDoorUnlockLeftConnectorProto: outer-port=AutomaticDoorUnlockLeft
    delegation sw connector AutomaticDoorUnlockRightConnectorProto: outer-port=AutomaticdoorUnlockRight
  system AutomaticdoorUnlockLeftSystem
    system mapping AutomaticDoorUnlockLeftSoftwareMapping: client-server-to-signal-mapping=communication-direction=OUT
      sw-impl-mappings:
        swc to impl mapping AutomativDoorUnlockLeftSwcToImpelmapping: component-implementation=AutomaticDoorUnlockImpFile, component=AutomaticDoorUnlockLeftRootSoftwareComposition.AutomaticDoorUnlockLeftSwComponentProto.AutomaticDoorUnlockLeftSwComponentProto
      sw-mappings:
        swc to ecu mapping AutomaticDoorUnlockLeftSwcToEcumapping: component=AutomaticDoorUnlockLeftRootSoftwareComposition.AutomaticDoorUnlockLeftSwComponentProto.AutomaticDoorUnlockLeftSwComponentProto, controlled-hw-element=/ARRoot/, ecu-instance=AutomaticDoorUnlockLeftECUInstance, processing-unit=/ARRoot/
    root-software-compositions:
      root sw composition prototype AutomaticDoorUnlockLeftRootSoftwareComposition
  system AutomaticdoorUnlockRightSystem
    system mapping AutomaticDoorUnlockRightSoftwareMapping: client-server-to-signal-mapping=communication-direction=OUT
      sw-impl-mappings:
        swc to impl mapping AutomativDoorUnlockRightSwcToImpelmapping: component-implementation=AutomaticDoorUnlockImpFile, component=AutomaticDoorUnlockRightRootSoftwareComposition.AutomaticDoorUnlockRightSwComponentProto.AutomaticDoorUnlockRightSwComponentProto
      sw-mappings:
        swc to ecu mapping AutomaticDoorUnlockRightSwcToEcumapping: component=AutomaticDoorUnlockRightRootSoftwareComposition.AutomaticDoorUnlockRightSwComponentProto.AutomaticDoorUnlockRightSwComponentProto, controlled-hw-element=/ARRoot/, ecu-instance=AutomaticDoorUnlockRightECUInstance, processing-unit=/ARRoot/
    root-software-compositions:
      root sw composition prototype AutomaticDoorUnlockRightRootSoftwareComposition
